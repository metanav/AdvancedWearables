## nrf52840_dongle_ble_peripheral_acc/build/Kconfig/Kconfig.shield
```kconfig
osource "/Users/naveen/nRF_source/ncs/nrf/boards/shields/*/Kconfig.shield"
osource "/Users/naveen/nRF_source/ncs/zephyr/boards/shields/*/Kconfig.shield"
osource "/Users/naveen/nRF_source/ncs/zephyr/boards/shields/*/Kconfig.shield"
```

## nrf5340_dk_ble_central_acc/build/Kconfig/Kconfig.soc.arch
```kconfig
osource "/Users/naveen/nRF_source/ncs/zephyr/soc/$(ARCH)/Kconfig"
osource "/Users/naveen/nRF_source/ncs/zephyr/soc/$(ARCH)/*/Kconfig"
```

## nrf5340_dk_ble_central_acc/build/hci_rpmsg/Kconfig/Kconfig.shield.defconfig
```kconfig
osource "/Users/naveen/nRF_source/ncs/nrf/boards/shields/*/Kconfig.defconfig"
osource "/Users/naveen/nRF_source/ncs/zephyr/boards/shields/*/Kconfig.defconfig"
osource "/Users/naveen/nRF_source/ncs/zephyr/boards/shields/*/Kconfig.defconfig"
```
