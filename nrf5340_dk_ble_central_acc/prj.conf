## CMakeLists.txt
```
cmake_minimum_required(VERSION 3.13.1)


set(SHIELD adafruit_2_8_tft_touch_v2)
find_package(Zephyr REQUIRED HINTS $ENV{ZEPHYR_BASE})

project(ble_central_acc)

target_sources(app PRIVATE src/main.c src/sd.c src/display.c src/ble_central.c src/calibri_20.c src/calibri_18.c)

zephyr_library_include_directories(${ZEPHYR_BASE}/samples/bluetooth)
```

## prj.conf
```kconfig
CONFIG_BT=y
CONFIG_BT_DEBUG_LOG=y
CONFIG_BT_CENTRAL=y
CONFIG_BT_SMP=y
CONFIG_BT_GATT_CLIENT=y
CONFIG_THREAD_STACK_INFO=y

CONFIG_DISPLAY=y
CONFIG_DISPLAY_LOG_LEVEL_ERR=y
CONFIG_LOG=y
CONFIG_LOG_IMMEDIATE=y
CONFIG_LOG_STRDUP_BUF_COUNT=500
CONFIG_LOG_DETECT_MISSED_STRDUP=n

CONFIG_LVGL=y
CONFIG_LVGL_ANTIALIAS=y
CONFIG_LVGL_USE_LABEL=y
CONFIG_LVGL_USE_CONT=y
CONFIG_LVGL_USE_CHART=y
CONFIG_LVGL_USE_CHECKBOX=y
CONFIG_LVGL_USE_BTN=y
CONFIG_LVGL_USE_BTNMATRIX=y
CONFIG_LVGL_USE_PAGE=y
CONFIG_LVGL_USE_DROPDOWN=y
CONFIG_LVGL_USE_MSGBOX=y
CONFIG_LVGL_USE_THEME_MATERIAL=y
CONFIG_LVGL_THEME_MATERIAL_DARK=y
CONFIG_LVGL_USE_ANIMATION=y
CONFIG_LVGL_USE_SHADOW=y
CONFIG_LVGL_FONT_MONTSERRAT_16=y

CONFIG_NEWLIB_LIBC=y

CONFIG_HEAP_MEM_POOL_SIZE=16384
CONFIG_MAIN_STACK_SIZE=4096

# ATT MTU and Data Length Extension
CONFIG_BT_L2CAP_TX_MTU=247
CONFIG_BT_L2CAP_RX_MTU=247
CONFIG_BT_RX_BUF_LEN=255
CONFIG_BT_CTLR_TX_BUFFER_SIZE=251
CONFIG_BT_CTLR_DATA_LENGTH_MAX=251
CONFIG_BT_USER_DATA_LEN_UPDATE=y

CONFIG_SPI=y
CONFIG_DISK_ACCESS=y
CONFIG_FILE_SYSTEM=y
CONFIG_FAT_FILESYSTEM_ELM=y
CONFIG_FS_FATFS_LFN=y
CONFIG_DISK_ACCESS_SDHC=y
CONFIG_DISK_ACCESS_SPI_SDHC=y
```

## src/main.c
```c
#include <zephyr.h>
#include "display.h"
#include "ble_central.h"

/* define notification mailbox 
 * to inform the threads
 */
K_MBOX_DEFINE(notification_mailbox);

/* define dedicated mailbox to forward data received from BLE peripheral to 
 * the display_thread
 */
K_MBOX_DEFINE(data_mailbox);

void main(void)
{
    ble_central_init();
    display_init();

    while (1) {
        k_sleep(K_MSEC(1000));
    }
}

/* display thread
 * stack size = 12288 to hold thread variables 
 * and 9K fatfs write buffer for 60 seconds of 
 * 25Hz 3-axis accelerometer data
 */
K_THREAD_DEFINE(display_thread, 12288, display_entrypoint, NULL, NULL, NULL, 7, 0, 0);
```

## src/ble_central.c
```c
#include <zephyr.h>
#include <stdio.h>
#include <string.h>

#include <bluetooth/bluetooth.h>
#include <bluetooth/hci.h>
#include <bluetooth/conn.h>
#include <bluetooth/uuid.h>
#include <bluetooth/gatt.h>
#include <sys/byteorder.h>

#include "ble_central.h"
#include "message.h"

#define ACC_SERVICE_UUID 0xd4, 0x86, 0x48, 0x24, 0x54, 0xB3, 0x43, 0xA1, \
                     0xBC, 0x20, 0x97, 0x8F, 0xC3, 0x76, 0xC2, 0x75

#define TX_CHAR_UUID 0xED, 0xAA, 0x20, 0x11, 0x92, 0xE7, 0x43, 0x5A, \
                 0xAA, 0xE9, 0x94, 0x43, 0x35, 0x6A, 0xD4, 0xD3

#define BT_UUID_ACC_SERVICE    BT_UUID_DECLARE_128(ACC_SERVICE_UUID)
#define BT_UUID_ACC_SERVICE_TX BT_UUID_DECLARE_128(TX_CHAR_UUID)

#define LOG_LEVEL CONFIG_LOG_DEFAULT_LEVEL
#include <logging/log.h>
LOG_MODULE_REGISTER(ble_central);

extern struct k_mbox data_mailbox;

extern struct k_mbox notification_mailbox;

static struct bt_conn *default_conn;
static struct bt_uuid_128 uuid = BT_UUID_INIT_128(0);
static struct bt_gatt_discover_params discover_params;
static struct bt_gatt_subscribe_params subscribe_params;
static struct bt_gatt_exchange_params exchange_params;

static void start_scan();


static void send_notification(enum noti_message msg)
{
    // send code using .info
    struct k_mbox_msg noti_msg = {
        .size = 0,
        .info = msg,
        .tx_data = NULL,
        .tx_block.data = NULL,
        .tx_target_thread = K_ANY
    };
    k_mbox_async_put(&notification_mailbox, &noti_msg, NULL);
}

static uint8_t notify_func(struct bt_conn *conn,
               struct bt_gatt_subscribe_params *params,
               const void *payload, uint16_t length)
{
    if (!payload) {
        params->value_handle = 0U;

        enum noti_message msg = BLE_PERIPHERAL_UNSUBSCRIBED;
        send_notification(msg);

        LOG_INF("[UNSUBSCRIBED]\n");

        return BT_GATT_ITER_STOP;
    }

    LOG_DBG("[NOTIFICATION] payload %p length %u\n", payload, length);
    
    uint8_t *data = (uint8_t*) payload;

    if (length == 2) {
        uint16_t code = data[0] | (data[1] << 8);
        LOG_ERR("Error: %d\n", code);
    } else { 
        struct k_mbox_msg data_msg = {
            .size = length,
            .tx_data = data,
            .tx_block.data = NULL,
            .tx_target_thread = K_ANY
        };

        k_mbox_async_put(&data_mailbox, &data_msg, NULL);
    }

    return BT_GATT_ITER_CONTINUE;
}

static void exchange_func(struct bt_conn *conn, uint8_t att_err,
                          struct bt_gatt_exchange_params *params)
{
    LOG_INF("MTU exchange %s\n", att_err == 0 ? "successful" : "failed");
}



static uint8_t discover_func(struct bt_conn *conn,
                 const struct bt_gatt_attr *attr,
                 struct bt_gatt_discover_params *params)
{
    int err;

    if (!attr) {
        printk("Discover complete\n");
        (void)memset(params, 0, sizeof(*params));
        return BT_GATT_ITER_STOP;
    }

    LOG_DBG("[ATTRIBUTE] handle %u\n", attr->handle);

    if (!bt_uuid_cmp(discover_params.uuid, BT_UUID_ACC_SERVICE)) {
        memcpy(&uuid, BT_UUID_ACC_SERVICE_TX, sizeof(uuid));
        discover_params.uuid = &uuid.uuid;
        discover_params.start_handle = attr->handle + 1;
        discover_params.type = BT_GATT_DISCOVER_CHARACTERISTIC;

        err = bt_gatt_discover(conn, &discover_params);
        if (err) {
            LOG_ERR("Discover failed (err %d)\n", err);
        }
    } else if (!bt_uuid_cmp(discover_params.uuid, BT_UUID_ACC_SERVICE_TX)) {
        memcpy(&uuid, BT_UUID_GATT_CCC, sizeof(uuid));
        discover_params.uuid = &uuid.uuid;
        discover_params.start_handle = attr->handle + 2;
        discover_params.type = BT_GATT_DISCOVER_DESCRIPTOR;
        subscribe_params.value_handle = bt_gatt_attr_value_handle(attr);

        err = bt_gatt_discover(conn, &discover_params);
        if (err) {
            LOG_ERR("Discover failed (err %d)\n", err);
        }
    } else {
        subscribe_params.notify = notify_func;
        subscribe_params.value = BT_GATT_CCC_NOTIFY;
        subscribe_params.ccc_handle = attr->handle;

        err = bt_gatt_subscribe(conn, &subscribe_params);
        if (err && err != -EALREADY) {
            LOG_ERR("Subscribe failed (err %d)\n", err);
        } else {
            LOG_DBG("[SUBSCRIBED] %u\n",  attr->handle);
        }

        return BT_GATT_ITER_STOP;
    }

    return BT_GATT_ITER_STOP;
}

static bool eir_found(struct bt_data *data, void *user_data)
{
    bt_addr_le_t *addr = user_data;
    LOG_DBG("[AD]: %u data_len %u\n", data->type, data->data_len);

    if ( data->type == BT_DATA_NAME_COMPLETE) {
        struct bt_le_conn_param *param;
        uint8_t name[data->data_len+1];
        memcpy(name, data->data, data->data_len);
            name[data->data_len] = 0;

        if (strcmp(name, "PERI_ACC")) {
            return true;
        }
            
        int err = bt_le_scan_stop();
        if (err) {
            LOG_ERR("Stop LE scan failed (err %d)\n", err);
            return true;
        }

        param = BT_LE_CONN_PARAM_DEFAULT;
        err = bt_conn_le_create(addr, BT_CONN_LE_CREATE_CONN,
                    param, &default_conn);
        if (err) {
            LOG_ERR("Create conn failed (err %d)\n", err);
            start_scan();
        }
            
        LOG_INF("Found:  %s\n", name);

        return false;
    }
    return true;
}

static void device_found(const bt_addr_le_t *addr, int8_t rssi, uint8_t type,
             struct net_buf_simple *ad)
{
    char dev[BT_ADDR_LE_STR_LEN];

    bt_addr_le_to_str(addr, dev, sizeof(dev));
    LOG_DBG("[DEVICE]: %s, AD evt type %u, AD data len %u, RSSI %i\n",
           dev, type, ad->len, rssi);

    /* We're only interested in connectable events */
    if (type == BT_GAP_ADV_TYPE_ADV_IND ||
        type == BT_GAP_ADV_TYPE_ADV_DIRECT_IND) {
        bt_data_parse(ad, eir_found, (void *)addr);
    }
}

static void start_scan()
{
    int err;

    /* Use active scanning and disable duplicate filtering to handle any
     * devices that might update their advertising data at runtime. */
    struct bt_le_scan_param scan_param = {
        .type       = BT_LE_SCAN_TYPE_ACTIVE,
        .options    = BT_LE_SCAN_OPT_NONE,
        .interval   = BT_GAP_SCAN_FAST_INTERVAL,
        .window     = BT_GAP_SCAN_FAST_WINDOW,
    };

    err = bt_le_scan_start(&scan_param, device_found);
    if (err) {
        LOG_ERR("Scanning failed to start (err %d)\n", err);
        return;
    }

    LOG_INF("Scanning successfully started\n");
    enum noti_message msg = BLE_PERIPHERAL_SCANNING;
    send_notification(msg);
}

static void connected(struct bt_conn *conn, uint8_t conn_err)
{
    char addr[BT_ADDR_LE_STR_LEN];
    int err;

    bt_addr_le_to_str(bt_conn_get_dst(conn), addr, sizeof(addr));

    if (conn_err) {
        LOG_ERR("Failed to connect to %s (%u)\n", addr, conn_err);

        bt_conn_unref(default_conn);
        default_conn = NULL;

        start_scan();
        return;
    }

    LOG_INF("Connected: %s\n", addr);
    enum noti_message msg = BLE_PERIPHERAL_CONNECTED;
    send_notification(msg);

    if (conn == default_conn) {
        memcpy(&uuid, BT_UUID_ACC_SERVICE, sizeof(uuid));
        discover_params.uuid = &uuid.uuid;
        discover_params.func = discover_func;
        discover_params.start_handle = 0x0001;
        discover_params.end_handle = 0xffff;
        discover_params.type = BT_GATT_DISCOVER_PRIMARY;

        err = bt_gatt_discover(default_conn, &discover_params);
        if (err) {
            LOG_ERR("Discover failed(err %d)\n", err);
            return;
        }

        /* Increase MTU size from 23 bytes to 160 bytes(defined in prj.conf) 
         * to send 25 samples (2 (16bit) * 3 (axis) * 25 bytes + some overhead) 
         * of accelerometer data
         */  
        exchange_params.func = exchange_func;

        err = bt_gatt_exchange_mtu(conn, &exchange_params);
        if (err) {
            LOG_ERR("MTU exchange failed (err %d)\n", err);
        } else {
            LOG_DBG("MTU exchange pending\n");
        } 

        struct bt_conn_le_data_len_param data_len = {
            .tx_max_len = 251,
            .tx_max_time = (251 + 14) * 8
        };

        err = bt_conn_le_data_len_update(conn, &data_len);
        if (err) {
            LOG_ERR("LE data length update failed: %d", err);
        } else {
            LOG_DBG("LE data length update OK\n");
        }

    }
}

static void disconnected(struct bt_conn *conn, uint8_t reason)
{
    char addr[BT_ADDR_LE_STR_LEN];

    bt_addr_le_to_str(bt_conn_get_dst(conn), addr, sizeof(addr));

    LOG_INF("Disconnected: %s (reason 0x%02x)\n", addr, reason);
    enum noti_message msg = BLE_PERIPHERAL_DISCONNECTED;
    send_notification(msg);

    if (default_conn != conn) {
        return;
    }

    bt_conn_unref(default_conn);
    default_conn = NULL;

    start_scan();
}

static struct bt_conn_cb conn_callbacks = {
    .connected = connected,
    .disconnected = disconnected,
};

void ble_central_init()
{
    int err = bt_enable(NULL);

    if (err) {
        LOG_ERR("Bluetooth init failed (err %d)\n", err);
        return;
    }

    LOG_INF("Bluetooth initialized\n");
    bt_conn_cb_register(&conn_callbacks);
    start_scan();
}
```

## src/ble_central.h
```c
#ifndef __BLE_CENTRAL_H
#define __BLE_CENTRAL_H

void ble_central_init();

#endif //__BLE_CENTRAL_H
```

## src/display.c
```c
#include <stdio.h>
#include "display.h"
#include "sd.h"
#include "message.h"

#define LABELS_COUNT 4
#define LOG_LEVEL CONFIG_LOG_DEFAULT_LEVEL
#include <logging/log.h>
LOG_MODULE_REGISTER(display);

LV_FONT_DECLARE(calibri_20);
LV_FONT_DECLARE(calibri_18);

extern struct k_mbox data_mailbox;
extern struct k_mbox notification_mailbox;

static lv_obj_t *btnm;
static lv_obj_t *mbox;
static lv_obj_t *status_label;

static lv_style_t style_label;
static lv_style_t style_btnm;
static lv_style_t style_mbox;
static lv_style_t style_err_mbox;

static int8_t btnm_states[LABELS_COUNT] = {0, 0, 0, 0};
static char labels[LABELS_COUNT][15] = {"Walking", "Running", "Sitting Good", "Sitting Bad"};
static char class_label[15];

static const char *btnm_map[] = {
    labels[0], labels[1], "\n", 
    labels[2], labels[3], ""
};

struct chart_type {
    lv_obj_t *chart_obj;
    lv_chart_series_t *series[3]; 
};

static bool recording = false;
static bool recording_ready = false;
static bool recording_done  = false;

void chart_init(struct chart_type *chart)
{   
    /* Create a chart */
    chart->chart_obj = lv_chart_create(lv_scr_act(), NULL);
    lv_obj_set_size(chart->chart_obj, 310, 80);
    lv_obj_align(chart->chart_obj, NULL, LV_ALIGN_IN_BOTTOM_MID, 0, -5);
    lv_chart_set_type(chart->chart_obj, LV_CHART_TYPE_LINE);   /*Show lines and points too*/
    // no grids
    lv_chart_set_div_line_count(chart->chart_obj, 0, 0);
    lv_chart_set_point_count(chart->chart_obj, 100);
    lv_obj_set_style_local_bg_color(chart->chart_obj, LV_CHART_PART_BG, LV_STATE_DEFAULT, LV_COLOR_BLACK);          
    lv_obj_set_style_local_border_color(chart->chart_obj, LV_CHART_PART_BG, LV_STATE_DEFAULT, LV_COLOR_BLACK);          

    // no points only lines
    lv_obj_set_style_local_size(chart->chart_obj, LV_CHART_PART_SERIES, LV_STATE_DEFAULT, 0);
    lv_chart_set_y_range(chart->chart_obj, LV_CHART_AXIS_PRIMARY_Y, -1536, 1536);

    /* Add three data series */
    chart->series[0] = lv_chart_add_series(chart->chart_obj, LV_COLOR_RED);
    chart->series[1] = lv_chart_add_series(chart->chart_obj, LV_COLOR_GREEN);
    chart->series[2] = lv_chart_add_series(chart->chart_obj, LV_COLOR_BLUE);
}

void chart_update(struct chart_type *chart, uint16_t *data, bool refresh)
{
    lv_chart_set_next(chart->chart_obj, chart->series[0], data[0]);
    lv_chart_set_next(chart->chart_obj, chart->series[1], data[1]);
    lv_chart_set_next(chart->chart_obj, chart->series[2], data[2]);
    if (refresh) {
        lv_chart_refresh(chart->chart_obj);
    }
}

static void style_init()
{
    lv_style_init(&style_label);
    lv_style_set_text_font(&style_label, LV_STATE_DEFAULT, &calibri_20);

    lv_style_init(&style_btnm);
    lv_style_set_text_font(&style_btnm, LV_STATE_DEFAULT, &calibri_20);

    lv_style_init(&style_mbox);
    lv_style_set_text_font(&style_mbox, LV_STATE_DEFAULT, &calibri_18);
    lv_style_set_text_color(&style_mbox, LV_STATE_DEFAULT, LV_COLOR_BLACK);


    lv_style_init(&style_err_mbox);
    lv_style_set_text_font(&style_err_mbox, LV_STATE_DEFAULT, &calibri_18);
    lv_style_set_text_color(&style_mbox, LV_STATE_DEFAULT, LV_COLOR_BLACK);
}

static void create_label()
{
    status_label = lv_label_create(lv_scr_act(), NULL);
    lv_label_set_text(status_label, "Press any button to start recording");
    lv_obj_align(status_label, NULL, LV_ALIGN_CENTER, 0, 15);
    lv_obj_add_style(status_label, LV_BTN_PART_MAIN, &style_label);
}

static void mbox_event_cb(lv_obj_t *obj, lv_event_t evt)
{
    if(evt == LV_EVENT_DELETE && obj == mbox) {
        LOG_INF("mbox: LV_EVENT_DELETE event was called\n"); 
        mbox = NULL;
        for (int8_t i=0; i<LABELS_COUNT; i++) {
            if (btnm_states[i] == 1) {
                strcpy(class_label, labels[i]); 
                recording = true;
                LOG_INF("mbox: Going to capture data for %s\n", labels[i]);
                break;
            }
        }
    } 
}

static void btn_matrix_event_handler(lv_obj_t *obj, lv_event_t event)
{
    uint16_t id = lv_btnmatrix_get_active_btn(obj);

    if(event == LV_EVENT_VALUE_CHANGED) {
        btnm_states[id] = !btnm_states[id];

        if (btnm_states[id] == 0) {
            if (mbox) {
                lv_msgbox_start_auto_close(mbox, 0);
            }

            for (uint8_t i=0; i < LABELS_COUNT; i++) {
                if (i != id) {
                    lv_btnmatrix_clear_btn_ctrl(obj, i, LV_BTNMATRIX_CTRL_DISABLED);
                }
            }

            if (recording) {
                // cancel recording
                recording = false;
                recording_done = false;
                recording_ready = false;

                mbox = lv_msgbox_create(lv_scr_act(), NULL);
                char str[50];
                sprintf(str, "Recording canceled", lv_btnmatrix_get_active_btn_text(obj));
                lv_msgbox_set_text(mbox, str);
                lv_msgbox_start_auto_close(mbox, 5000);
                lv_obj_set_size(mbox, LV_HOR_RES/2, LV_VER_RES/4);
                lv_obj_add_style(mbox, LV_BTN_PART_MAIN, &style_mbox);
                lv_obj_set_pos(mbox, LV_HOR_RES/4,  LV_VER_RES/2);
                lv_obj_set_style_local_bg_color(mbox, LV_BTNMATRIX_PART_BG, LV_STATE_DEFAULT, LV_COLOR_GREEN);

                lv_label_set_text(status_label, "Press any button to start recording");
            }
        } else {
            for (uint8_t i=0; i < LABELS_COUNT; i++) {
                if (i != id) {
                    lv_btnmatrix_set_btn_ctrl(obj, i, LV_BTNMATRIX_CTRL_DISABLED);
                }
            }

            mbox = lv_msgbox_create(lv_scr_act(), NULL);
            char str[50];
            sprintf(str, "[%s]\nStarting in 5s", lv_btnmatrix_get_active_btn_text(obj));
            lv_msgbox_set_text(mbox,str);
            lv_msgbox_start_auto_close(mbox, 5000);
            lv_obj_set_event_cb(mbox, mbox_event_cb);
            lv_obj_set_size(mbox, LV_HOR_RES/2, LV_VER_RES/4);
            lv_obj_add_style(mbox, LV_BTN_PART_MAIN, &style_mbox);
            lv_obj_set_pos(mbox, LV_HOR_RES/4,  LV_VER_RES/2);
            lv_obj_set_style_local_bg_color(mbox, LV_BTNMATRIX_PART_BG, LV_STATE_DEFAULT, LV_COLOR_GREEN);
        }
    }
}

lv_obj_t *err_mbox;

static void err_mbox_event_cb(lv_obj_t *obj, lv_event_t evt)
{
     LOG_INF("err_mbox_event_cb was called\n");

     if(evt == LV_EVENT_VALUE_CHANGED) {
        lv_msgbox_start_auto_close(err_mbox, 0);
     }
}

void show_err_mbox(enum noti_message msg)
{
    char message[30];
    bool auto_close;

    LOG_INF("msg=%d\n", msg);

    switch (msg)
    {
        case BLE_PERIPHERAL_DISCONNECTED:
            strcpy(message, "BLE PERIPHERAL DISCONNECTED");  
            auto_close = true;
            break;
        case BLE_PERIPHERAL_CONNECTED:
            strcpy(message, "BLE PERIPHERAL CONNECTED");  
            auto_close = true;
            break;
        case BLE_PERIPHERAL_UNSUBSCRIBED:
            strcpy(message, "BLE PERIPHERAL UNSUBSCRIBED");  
            auto_close = true;
            break;
        case BLE_PERIPHERAL_SUBSCRIBED:
            strcpy(message, "BLE PERIPHERAL SUBSCRIBED");  
            auto_close = true;
            break;
        case BLE_PERIPHERAL_SCANNING:
            strcpy(message, "BLE PERIPHERAL SCANNING");  
            auto_close = true;
            break;
        case BLE_PERIPHERAL_FOUND:
            strcpy(message, "BLE PERIPHERAL FOUND");  
            auto_close = true;
            break;
        case SD_CARD_ERROR:
            strcpy(message, "Check SD card");  
            auto_close = false;
            break;
        default:
            strcpy(message, "Something gone wrong!");  
            auto_close = false;
    }

    LOG_DBG("message=%s\n", message);

    err_mbox = lv_msgbox_create(lv_scr_act(), NULL);
    static const char * btns[] = {"OK", ""};

    lv_msgbox_set_text(err_mbox, message);
    
    lv_obj_set_size(err_mbox, (LV_HOR_RES*3)/4, LV_VER_RES/4);
    lv_obj_add_style(err_mbox, LV_BTN_PART_MAIN, &style_err_mbox);
    lv_obj_align(err_mbox, NULL, LV_ALIGN_CENTER, 0, 0);
    lv_obj_set_style_local_bg_color(err_mbox, LV_MSGBOX_PART_BG, LV_STATE_DEFAULT, LV_COLOR_GREEN);

    if (auto_close) {
        lv_msgbox_start_auto_close(err_mbox, 5000);
    } else {
        lv_msgbox_add_btns(err_mbox, btns);
        lv_obj_set_event_cb(err_mbox, err_mbox_event_cb);
    }

}

void create_btn_matrix(void)
{
    btnm = lv_btnmatrix_create(lv_scr_act(), NULL);
    lv_btnmatrix_set_map(btnm, btnm_map);
    lv_btnmatrix_set_btn_ctrl_all(btnm,  LV_BTNMATRIX_CTRL_CHECKABLE);

    lv_obj_add_style(btnm, LV_BTN_PART_MAIN, &style_btnm);
    lv_obj_align(btnm, NULL, LV_ALIGN_IN_TOP_MID, 0, 0);
    lv_obj_set_event_cb(btnm, btn_matrix_event_handler);
    lv_obj_set_style_local_bg_color(btnm, LV_BTNMATRIX_PART_BTN, LV_STATE_DEFAULT, LV_COLOR_BLUE);
}

void display_entrypoint(void)
{
    const struct device *display_dev;
    display_dev = device_get_binding(CONFIG_LVGL_DISPLAY_DEV_NAME);

    if (display_dev == NULL) {
        LOG_ERR("%s device not found.  Aborting test.", CONFIG_LVGL_DISPLAY_DEV_NAME);
        return;
    }

    style_init();
    display_blanking_off(display_dev);
    create_btn_matrix();
    create_label();

    LOG_INF("Display %s initialized\n", CONFIG_LVGL_DISPLAY_DEV_NAME);

    struct k_mbox_msg recv_n_msg;
    struct k_mbox_msg recv_d_msg;
    struct chart_type acc_chart;
    chart_init(&acc_chart);
    uint8_t count = 0;
    bool refresh;
    uint8_t buffer[150];
    int16_t data[3];
    int rec_i = 0;
    const int rec_buf_size = 4500;
    int16_t rec_buf[rec_buf_size];

    while (1) {
        if (recording == true && recording_ready == false) {
             recording_ready = true;
             memset(rec_buf, 0, rec_buf_size); 
             rec_i = 0;
        }

        recv_n_msg.rx_source_thread = K_ANY;

        if (0 == k_mbox_get(&notification_mailbox, &recv_n_msg, NULL, K_NO_WAIT)) {
            LOG_INF("recv_n_msg.info=%d\n", recv_n_msg.info);
            show_err_mbox((enum noti_message) recv_n_msg.info);
        }

        refresh = false;
        recv_d_msg.size = 150;
        recv_d_msg.rx_source_thread = K_ANY;

        if (0 == k_mbox_get(&data_mailbox, &recv_d_msg, NULL, K_NO_WAIT)) {
            k_mbox_data_get(&recv_d_msg, buffer);

            LOG_DBG("recv_msg size=%d\n", recv_d_msg.size);

            for (uint8_t i = 0; i < 150; i += 6) {
                data[0] = buffer[i+0] | (buffer[i+1] << 8);
                data[1] = buffer[i+2] | (buffer[i+3] << 8);
                data[2] = buffer[i+4] | (buffer[i+5] << 8);

                if (++count == 25) {
                    count = 0;
                    refresh = true;
                }

                chart_update(&acc_chart, data, refresh);

                if (recording && recording_ready) {
                    rec_buf[rec_i++] = data[0];
                    rec_buf[rec_i++] = data[1];
                    rec_buf[rec_i++] = data[2];

                    if (rec_i > rec_buf_size-1) {
                        recording_done = true;
                    }
                }
            }

            if (recording && recording_ready) {        
                lv_label_set_text_fmt(status_label, "Recording: %d samples", rec_i/3);
                LOG_INF("Recording: %d samples",  rec_i/3);
            }
        }

       if (recording && recording_done) {
            recording = false;
            recording_done = false;
            recording_ready = false;

            LOG_INF("Writing to SD..\n");

            if (!write_to_sd(class_label, rec_buf, rec_buf_size)) {
                lv_label_set_text(status_label, "Write to SD card failed.");
            } else {
                lv_label_set_text(status_label, "Data saved to SD card.");
            }
       }

        lv_task_handler();
        k_sleep(K_MSEC(5));
    }
}

void display_init() 
{
    k_sleep(K_MSEC(1000));

    if (!sd_init()) {
        enum noti_message msg = BLE_PERIPHERAL_UNSUBSCRIBED;
        show_err_mbox(msg);
    }

    LOG_INF("Display initialized\n");
}
```

## src/display.h
```c
#ifndef __DISPLAY_H
#define __DISPLAY_H

#include <zephyr/types.h>
#include <stddef.h>
#include <errno.h>
#include <zephyr.h>

#include <device.h>
#include <drivers/display.h>
#include <lvgl.h>
#include <string.h>

void display_init();

#endif //__DISPLAY_H
```

## src/message.h
```c
#ifndef __MSG_H
#define __MSG_H

enum noti_message {
    BLE_PERIPHERAL_DISCONNECTED=1,
    BLE_PERIPHERAL_CONNECTED,
    BLE_PERIPHERAL_UNSUBSCRIBED,
    BLE_PERIPHERAL_SUBSCRIBED,
    BLE_PERIPHERAL_SCANNING,
    BLE_PERIPHERAL_FOUND,
    SD_CARD_ERROR
};

#endif //__MSG_H
```

## src/sd.c
```c
#include <stdio.h>
#include <disk/disk_access.h>
#include <fs/fs.h>
#include <ff.h>
#include "sd.h"

#define LOG_LEVEL CONFIG_LOG_DEFAULT_LEVEL
#include <logging/log.h>
LOG_MODULE_REGISTER(sd);

/*
*  Note the fatfs library is able to mount only strings inside _VOLUME_STRS
*  in ffconf.h
*/
static const char *disk_mount_pt = "/SD:";
static long int counter;
static const char counter_file[] = "/SD:/counter.txt";
static FATFS fat_fs;

/* mounting info */
static struct fs_mount_t mp = {
    .type = FS_FATFS,
    .fs_data = &fat_fs,
};



static int lsdir(const char *path);

bool sd_init()
{
    do { 
        static const char *disk_pdrv = "SD";
        uint64_t memory_size_mb;
        uint32_t block_count;
        uint32_t block_size;
    
        if (disk_access_init(disk_pdrv) != 0) {
            LOG_ERR("Storage init ERROR!");
            return false;
        }
    
        if (disk_access_ioctl(disk_pdrv,
                DISK_IOCTL_GET_SECTOR_COUNT, &block_count)) {
            LOG_ERR("Unable to get sector count");
            return false;
        }

        LOG_INF("Block count %u", block_count);
    
        if (disk_access_ioctl(disk_pdrv, DISK_IOCTL_GET_SECTOR_SIZE, &block_size)) {
            LOG_ERR("Unable to get sector size");
            return false;
        }

        LOG_INF("Sector size %u\n", block_size);
    
        memory_size_mb = (uint64_t)block_count * block_size;

        LOG_INF("Memory Size(MB) %u\n", (uint32_t)(memory_size_mb >> 20));
    } while (0);

    mp.mnt_point = disk_mount_pt;
    int res = fs_mount(&mp);
    
    if (res == FR_OK) {
        LOG_INF("Disk mounted.\n");
        lsdir(disk_mount_pt);

        struct fs_file_t fp;
        
        // check if file exists
        int ret = fs_open(&fp, counter_file, 0);
        if (ret == 0) {
            fs_close(&fp);
        } 
        if (ret == -2) {
            LOG_INF("File does not exist, creating new one!\n");
            ret = fs_open(&fp, counter_file, FS_O_CREATE | FS_O_WRITE);
            if (ret == 0) {
                char buf[2] = "0";
                fs_write(&fp, &buf, 1);
                fs_close(&fp);
                LOG_INF("Write 0 to the file\n");
            }
        }
 
        ret = fs_open(&fp, counter_file, FS_O_READ);
        
        if (ret == 0) {
            char buf[5];
            fs_read(&fp, buf, 5);
            fs_close(&fp);
            sscanf(buf, "%ld", &counter);
            LOG_INF("counter=%ld\n", counter);
        } else {
            LOG_ERR("counter could not be initialized\n");
            return false;
        }
    } else {
        LOG_ERR("Error mounting disk.\n");
        return false;
    }

    return true;
}


bool write_to_sd(const char *label, int16_t *buf, size_t bufsize)
{
    struct fs_file_t fp;
    char datafile[25];

    // convert first space to underscore
    char *ptr = strchr(label, ' ');
    if (ptr!=NULL) {
        ptr[0] = '_';
    }

    counter += 1;
    
    sprintf(datafile, "/SD:/%s.%ld.csv", label, counter); 
    LOG_INF("counter=%ld, datafile: %s\n", counter, datafile);

    int ret = fs_open(&fp, datafile, FS_O_CREATE | FS_O_WRITE);

    if (ret != 0) {
        LOG_ERR("Failed to open file: %d\n", ret);
        return false;
    }
    
    LOG_ERR("Start writing to %s\n", datafile);
    
    for (int i=0; i<bufsize; i += 3) {
        char line[20];
        ssize_t bufsz = snprintf(line, 20,  "%d,%d,%d\n", buf[i], buf[i+1], buf[i+2]);
        
        //LOG_INF("line=%s", line);

        ret = fs_write(&fp, line, bufsz);

        if (ret < 0) {
            LOG_ERR("Failed to write: %d\n", ret);
            return false;
        }
    }
 
    fs_close(&fp);

    ret = fs_open(&fp, counter_file, FS_O_WRITE);
    if (ret == 0) {
        char buf[5];
        ssize_t bufsz = snprintf(buf, 5, "%ld", counter);
        fs_write(&fp, buf, bufsz);
        fs_close(&fp);
        LOG_INF("counter=%ld written to the file\n", counter);
    } 
    fs_close(&fp);
    
    LOG_INF("Data written to %s\n", datafile);

    return true;
}

static int lsdir(const char *path)
{
        int res;
        struct fs_dir_t dirp;
        static struct fs_dirent entry;

        /* Verify fs_opendir() */
        res = fs_opendir(&dirp, path);
        if (res) {
            LOG_ERR("Error opening dir %s [%d]\n", path, res);
            return res;
        }

        LOG_INF("\nListing dir %s ...\n", path);
        for (;;) {
            /* Verify fs_readdir() */
            res = fs_readdir(&dirp, &entry);

            /* entry.name[0] == 0 means end-of-dir */
            if (res || entry.name[0] == 0) {
                break;
            }

            if (entry.type == FS_DIR_ENTRY_DIR) {
                LOG_INF("[DIR ] %s\n", entry.name);
            } else {
                LOG_INF("[FILE] %s (size = %zu)\n", entry.name, entry.size);
            }
        }

        /* Verify fs_closedir() */
        fs_closedir(&dirp);

        return res;
}
```

## src/sd.h
```c
#ifndef __SD_H
#define __SD_H

#include <zephyr/types.h>
#include <errno.h>
#include <zephyr.h>
 
bool sd_init();
bool write_to_sd(const char *label, int16_t *buf, size_t bufsize);

#endif //__SD_H
```
