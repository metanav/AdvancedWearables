## CMakeLists.txt
```
cmake_minimum_required(VERSION 3.13.1)

set(SHIELD adafruit_2_8_tft_touch_v2)

set(CMAKE_CXX_STANDARD 11)
set(CMAKE_CXX_STANDARD_REQUIRED ON)

find_package(Zephyr REQUIRED HINTS $ENV{ZEPHYR_BASE})

project(nrf5340_dk_inf)

include(edge-impulse-sdk/cmake/utils.cmake)

# Needed for colorful output
zephyr_compile_options(-fdiagnostics-color=always)

# Use hardware acceleration for DSP and Neural Network code
add_definitions(-DEIDSP_USE_CMSIS_DSP=1
                -DEI_CLASSIFIER_TFLITE_ENABLE_CMSIS_NN=1
                -DARM_MATH_LOOPUNROLL
                )

# Add the Edge Impulse SDK
add_subdirectory(edge-impulse-sdk/cmake/zephyr)

# Edge impulse SDK include directories
set(INCLUDES
    .
    src
    tflite-model
    model-parameters
    )
include_directories(${INCLUDES})

RECURSIVE_FIND_FILE(MODEL_FILES "tflite-model" "*.cpp")
list(APPEND SOURCE_FILES ${MODEL_FILES})

# add all sources to the project
target_sources(app PRIVATE ${SOURCE_FILES})
target_sources(app PRIVATE src/main.cpp  src/sd.cpp src/display.cpp src/ble_central.c 
               src/calibri_20.cpp src/calibri_18.cpp src/calibri_32b.cpp)
```

## prj.conf
```kconfig
CONFIG_CPLUSPLUS=y
CONFIG_LIB_CPLUSPLUS=y
CONFIG_NEWLIB_LIBC=y
CONFIG_NEWLIB_LIBC_FLOAT_PRINTF=y
CONFIG_FPU=y

CONFIG_BT=y
CONFIG_BT_DEBUG_LOG=y
CONFIG_BT_CENTRAL=y
CONFIG_BT_SMP=y
CONFIG_BT_GATT_CLIENT=y
CONFIG_THREAD_STACK_INFO=y

CONFIG_DISPLAY=y
CONFIG_DISPLAY_LOG_LEVEL_ERR=y
CONFIG_LOG=y
CONFIG_LOG_IMMEDIATE=y
CONFIG_LOG_STRDUP_BUF_COUNT=500
CONFIG_LOG_DETECT_MISSED_STRDUP=n

CONFIG_LVGL=y
CONFIG_LVGL_ANTIALIAS=y
CONFIG_LVGL_USE_LABEL=y
CONFIG_LVGL_USE_CONT=y
CONFIG_LVGL_USE_CHART=y
CONFIG_LVGL_USE_CHECKBOX=y
CONFIG_LVGL_USE_BTN=y
CONFIG_LVGL_USE_BTNMATRIX=y
CONFIG_LVGL_USE_PAGE=y
CONFIG_LVGL_USE_DROPDOWN=y
CONFIG_LVGL_USE_MSGBOX=y
CONFIG_LVGL_USE_THEME_MATERIAL=y
CONFIG_LVGL_THEME_MATERIAL_DARK=y
CONFIG_LVGL_USE_ANIMATION=y
CONFIG_LVGL_USE_SHADOW=y
CONFIG_LVGL_FONT_MONTSERRAT_16=y

CONFIG_NEWLIB_LIBC=y

CONFIG_HEAP_MEM_POOL_SIZE=16384
CONFIG_MAIN_STACK_SIZE=4096

# ATT MTU and Data Length Extension
CONFIG_BT_L2CAP_TX_MTU=247
CONFIG_BT_L2CAP_RX_MTU=247
CONFIG_BT_RX_BUF_LEN=255
CONFIG_BT_CTLR_TX_BUFFER_SIZE=251
CONFIG_BT_CTLR_DATA_LENGTH_MAX=251
CONFIG_BT_USER_DATA_LEN_UPDATE=y

CONFIG_SPI=y
CONFIG_DISK_ACCESS=y
CONFIG_FILE_SYSTEM=y
CONFIG_FAT_FILESYSTEM_ELM=y
CONFIG_FS_FATFS_LFN=y
CONFIG_DISK_ACCESS_SDHC=y
CONFIG_DISK_ACCESS_SPI_SDHC=y
```

## src/main.cpp
```c
#include <zephyr.h>
#include "display.h"
#include "ble_central.h"


/* define notification mailbox 
 * to inform the threads
 */
K_MBOX_DEFINE(notification_mailbox);

/* define dedicated mailbox to forward data received from BLE peripheral to 
 * the display_thread
 */
K_MBOX_DEFINE(data_mailbox);

void main(void)
{
    ble_central_init();
    // the edge impulse inferencing code is in the display.cpp file
    display_init();

    while (1) {
        k_sleep(K_MSEC(1000));
    }
}

/* display thread
 * stack size = 8192 to hold thread variables 
 */
K_THREAD_DEFINE(display_thread, 8192, display_entrypoint, NULL, NULL, NULL, 7, 0, 0);
```

## src/ble_central.h
```c
#ifndef __BLE_CENTRAL_H
#define __BLE_CENTRAL_H

#ifdef __cplusplus
extern "C"
{
#endif

void ble_central_init();

#ifdef __cplusplus
} 
#endif

#endif //__BLE_CENTRAL_H
```

## src/display.cpp
```c
#include <stdio.h>
#include "display.h"
#include "message.h"

#include "ei_run_classifier.h"
#include "numpy.hpp"

#define LABELS_COUNT 4
#define LOG_LEVEL CONFIG_LOG_DEFAULT_LEVEL
#include <logging/log.h>
LOG_MODULE_REGISTER(display);

LV_FONT_DECLARE(calibri_32b);
LV_FONT_DECLARE(calibri_20);
LV_FONT_DECLARE(calibri_18);

extern struct k_mbox data_mailbox;
extern struct k_mbox notification_mailbox;

static lv_obj_t *mbox;
lv_obj_t *err_mbox;
static lv_obj_t *status_label;
static lv_obj_t *recognition_label;

static lv_style_t style_label;
static lv_style_t style_mbox;
static lv_style_t style_err_mbox;
static lv_style_t style_recognition_label;

static char labels[LABELS_COUNT][15] = {"Walking", "Running", "Sitting Good", "Sitting Bad"};

struct chart_type {
    lv_obj_t *chart_obj;
    lv_chart_series_t *series[3]; 
};

void chart_init(struct chart_type *chart)
{   
    /* Create a chart */
    chart->chart_obj = lv_chart_create(lv_scr_act(), NULL);
    lv_obj_set_size(chart->chart_obj, 310, 80);
    lv_obj_align(chart->chart_obj, NULL, LV_ALIGN_IN_BOTTOM_MID, 0, -5);
    lv_chart_set_type(chart->chart_obj, LV_CHART_TYPE_LINE);   /*Show lines and points too*/
    // no grids
    lv_chart_set_div_line_count(chart->chart_obj, 0, 0);
    lv_chart_set_point_count(chart->chart_obj, 100);
    lv_obj_set_style_local_bg_color(chart->chart_obj, LV_CHART_PART_BG, LV_STATE_DEFAULT, LV_COLOR_BLACK);          
    lv_obj_set_style_local_border_color(chart->chart_obj, LV_CHART_PART_BG, LV_STATE_DEFAULT, LV_COLOR_BLACK);          

    // no points only lines
    lv_obj_set_style_local_size(chart->chart_obj, LV_CHART_PART_SERIES, LV_STATE_DEFAULT, 0);
    lv_chart_set_y_range(chart->chart_obj, LV_CHART_AXIS_PRIMARY_Y, -1536, 1536);

    /* Add three data series */
    chart->series[0] = lv_chart_add_series(chart->chart_obj, LV_COLOR_RED);
    chart->series[1] = lv_chart_add_series(chart->chart_obj, LV_COLOR_GREEN);
    chart->series[2] = lv_chart_add_series(chart->chart_obj, LV_COLOR_BLUE);
}

void chart_update(struct chart_type *chart, int16_t *data, bool refresh)
{
    lv_chart_set_next(chart->chart_obj, chart->series[0], data[0]);
    lv_chart_set_next(chart->chart_obj, chart->series[1], data[1]);
    lv_chart_set_next(chart->chart_obj, chart->series[2], data[2]);
    if (refresh) {
        lv_chart_refresh(chart->chart_obj);
    }
}

static void style_init()
{
    lv_style_init(&style_label);
    lv_style_set_text_font(&style_label, LV_STATE_DEFAULT, &calibri_20);

    lv_style_init(&style_recognition_label);
    lv_style_set_text_font(&style_recognition_label, LV_STATE_DEFAULT, &calibri_32b);

    lv_style_init(&style_mbox);
    lv_style_set_text_font(&style_mbox, LV_STATE_DEFAULT, &calibri_18);
    lv_style_set_text_color(&style_mbox, LV_STATE_DEFAULT, LV_COLOR_BLACK);

    lv_style_init(&style_err_mbox);
    lv_style_set_text_font(&style_err_mbox, LV_STATE_DEFAULT, &calibri_18);
    lv_style_set_text_color(&style_mbox, LV_STATE_DEFAULT, LV_COLOR_BLACK);
}

static void create_label()
{
    status_label = lv_label_create(lv_scr_act(), NULL);
    lv_label_set_text(status_label, "");
    lv_obj_align(status_label, NULL, LV_ALIGN_CENTER, 0, 15);
    lv_obj_add_style(status_label, LV_BTN_PART_MAIN, &style_label);
}

static void create_recognition_label()
{
    recognition_label = lv_label_create(lv_scr_act(), NULL);
    lv_label_set_text(recognition_label, "Please wait for data.");
    lv_obj_align(recognition_label, NULL, LV_ALIGN_CENTER, 0, -50);
    lv_obj_add_style(recognition_label, LV_BTN_PART_MAIN, &style_recognition_label);
}

static void mbox_event_cb(lv_obj_t *obj, lv_event_t evt)
{
    if(evt == LV_EVENT_DELETE && obj == mbox) {
        LOG_INF("mbox: LV_EVENT_DELETE event was called\n"); 
        mbox = NULL;
    } 
}

static void err_mbox_event_cb(lv_obj_t *obj, lv_event_t evt)
{
     LOG_INF("err_mbox_event_cb was called\n");

     if(evt == LV_EVENT_VALUE_CHANGED) {
        lv_msgbox_start_auto_close(err_mbox, 0);
     }
}

void show_err_mbox(enum noti_message msg)
{
    char message[30];
    bool auto_close;

    LOG_INF("msg=%d\n", msg);

    switch (msg)
    {
        case BLE_PERIPHERAL_DISCONNECTED:
            strcpy(message, "BLE PERIPHERAL DISCONNECTED");  
            auto_close = true;
            break;
        case BLE_PERIPHERAL_CONNECTED:
            strcpy(message, "BLE PERIPHERAL CONNECTED");  
            auto_close = true;
            break;
        case BLE_PERIPHERAL_UNSUBSCRIBED:
            strcpy(message, "BLE PERIPHERAL UNSUBSCRIBED");  
            auto_close = true;
            break;
        case BLE_PERIPHERAL_SUBSCRIBED:
            strcpy(message, "BLE PERIPHERAL SUBSCRIBED");  
            auto_close = true;
            break;
        case BLE_PERIPHERAL_SCANNING:
            strcpy(message, "BLE PERIPHERAL SCANNING");  
            auto_close = true;
            break;
        case BLE_PERIPHERAL_FOUND:
            strcpy(message, "BLE PERIPHERAL FOUND");  
            auto_close = true;
            break;
        case SD_CARD_ERROR:
            strcpy(message, "Check SD card");  
            auto_close = false;
            break;
        default:
            strcpy(message, "Something gone wrong!");  
            auto_close = false;
    }

    LOG_DBG("message=%s\n", message);

    err_mbox = lv_msgbox_create(lv_scr_act(), NULL);
    static const char * btns[] = {"OK", ""};

    lv_msgbox_set_text(err_mbox, message);
    
    lv_obj_set_size(err_mbox, (LV_HOR_RES*3)/4, LV_VER_RES/4);
    lv_obj_add_style(err_mbox, LV_BTN_PART_MAIN, &style_err_mbox);
    lv_obj_align(err_mbox, NULL, LV_ALIGN_CENTER, 0, 0);
    lv_obj_set_style_local_bg_color(err_mbox, LV_MSGBOX_PART_BG, LV_STATE_DEFAULT, LV_COLOR_GREEN);

    if (auto_close) {
        lv_msgbox_start_auto_close(err_mbox, 5000);
    } else {
        lv_msgbox_add_btns(err_mbox, btns);
        lv_obj_set_event_cb(err_mbox, err_mbox_event_cb);
    }

}

static float features[EI_CLASSIFIER_DSP_INPUT_FRAME_SIZE] = {0.0f};

int raw_feature_get_data(size_t offset, size_t length, float *out_ptr) {
    memcpy(out_ptr, features + offset, length * sizeof(float));
    return 0;
}

void display_entrypoint(void)
{
    const struct device *display_dev;
    display_dev = device_get_binding(CONFIG_LVGL_DISPLAY_DEV_NAME);

    if (display_dev == NULL) {
        LOG_ERR("%s device not found.  Aborting test.", CONFIG_LVGL_DISPLAY_DEV_NAME);
        return;
    }

    style_init();
    display_blanking_off(display_dev);
    create_recognition_label();
    create_label();

    LOG_INF("Display %s initialized\n", CONFIG_LVGL_DISPLAY_DEV_NAME);

    struct k_mbox_msg recv_n_msg;
    struct k_mbox_msg recv_d_msg;
    struct chart_type acc_chart;
    chart_init(&acc_chart);
    uint8_t count = 0;
    bool refresh;
    uint8_t buffer[150];
    int16_t data[3];


    // This is needed so that output of printf is output immediately without buffering
    setvbuf(stdout, NULL, _IONBF, 0);

    LOG_INF("Edge Impulse inferencing \n");

    if (sizeof(features) / sizeof(float) != EI_CLASSIFIER_DSP_INPUT_FRAME_SIZE) {
        LOG_INF("The size of your 'features' array is not correct. Expected %d items, but had %u\n",
            EI_CLASSIFIER_DSP_INPUT_FRAME_SIZE, sizeof(features) / sizeof(float));
        return;
    }

    ei_impulse_result_t result = { 0 };

    uint8_t data_block= 0;
    bool do_inferencing = false;

    while (1) {
        recv_n_msg.rx_source_thread = K_ANY;

        if (0 == k_mbox_get(&notification_mailbox, &recv_n_msg, NULL, K_NO_WAIT)) {
            LOG_INF("recv_n_msg.info=%d\n", recv_n_msg.info);
            show_err_mbox((enum noti_message) recv_n_msg.info);
        }

        refresh = false;
        recv_d_msg.size = 150;
        recv_d_msg.rx_source_thread = K_ANY;

        if (0 == k_mbox_get(&data_mailbox, &recv_d_msg, NULL, K_NO_WAIT)) {
            k_mbox_data_get(&recv_d_msg, buffer);

            LOG_DBG("recv_msg size=%d\n", recv_d_msg.size);

            for (uint8_t i = 0; i < 150; i += 6) {
                data[0] = buffer[i+0] | (buffer[i+1] << 8);
                data[1] = buffer[i+2] | (buffer[i+3] << 8);
                data[2] = buffer[i+4] | (buffer[i+5] << 8);

                if (++count == 25) {
                    count = 0;
                    refresh = true;
                }

                chart_update(&acc_chart, data, refresh);
                
                uint8_t j = (data_block == 0) ? i/2 : 75 + (i/2);
                features[j+0] = data[0];
                features[j+1] = data[1];
                features[j+2] = data[2];
            }
           
            do_inferencing = (data_block == 1) ? true : false;
            
            data_block ^= 1;
        }

        if (do_inferencing) {
            // the features are stored into flash, and we don't want to load everything into RAM
            signal_t features_signal;
            features_signal.total_length = sizeof(features) / sizeof(features[0]);
            features_signal.get_data = &raw_feature_get_data;

            // invoke the impulse
            EI_IMPULSE_ERROR res = run_classifier(&features_signal, &result, true);
            LOG_INF("run_classifier returned: %d\n", res);

            if (res != 0) return;

            LOG_INF("Predictions (DSP: %d ms., Classification: %d ms., Anomaly: %d ms.): \n",
                result.timing.dsp, result.timing.classification, result.timing.anomaly);

            // print the predictions
            LOG_INF("[");
            uint8_t max_ix;
            float max_value = 0.0f;
            for (size_t ix = 0; ix < EI_CLASSIFIER_LABEL_COUNT; ix++) {
                if (result.classification[ix].value > max_value) {
                    max_value = result.classification[ix].value;
                    max_ix = ix;
                }
                ei_printf_float(result.classification[ix].value);
                if (ix != EI_CLASSIFIER_LABEL_COUNT - 1) {
                    LOG_INF(", ");
                }
            }
            LOG_INF("]\n");
            lv_label_set_text(recognition_label, result.classification[max_ix].label);
        }

        lv_task_handler();
    }
}

void display_init() 
{
    k_sleep(K_MSEC(1000));
    LOG_INF("Display initialized\n");
}
```

## src/display.h
```c
#ifndef __DISPLAY_H
#define __DISPLAY_H

#include <zephyr/types.h>
#include <stddef.h>
#include <errno.h>
#include <zephyr.h>

#include <device.h>
#include <drivers/display.h>
#include <lvgl.h>
#include <string.h>

void display_init();
void display_entrypoint(void);

#endif //__DISPLAY_H
```

## src/sd.cpp
```c
#include <stdio.h>
#include <disk/disk_access.h>
#include <fs/fs.h>
#include <ff.h>
#include "sd.h"

#define LOG_LEVEL CONFIG_LOG_DEFAULT_LEVEL
#include <logging/log.h>
LOG_MODULE_REGISTER(sd);

/*
*  Note the fatfs library is able to mount only strings inside _VOLUME_STRS
*  in ffconf.h
*/
static const char *disk_mount_pt = "/SD:";
static long int counter;
static const char counter_file[] = "/SD:/counter.txt";
static FATFS fat_fs;

/* mounting info */
static struct fs_mount_t mp = {
    .type = FS_FATFS,
    .fs_data = &fat_fs,
};



static int lsdir(const char *path);

bool sd_init()
{
    do { 
        static const char *disk_pdrv = "SD";
        uint64_t memory_size_mb;
        uint32_t block_count;
        uint32_t block_size;
    
        if (disk_access_init(disk_pdrv) != 0) {
            LOG_ERR("Storage init ERROR!");
            return false;
        }
    
        if (disk_access_ioctl(disk_pdrv,
                DISK_IOCTL_GET_SECTOR_COUNT, &block_count)) {
            LOG_ERR("Unable to get sector count");
            return false;
        }

        LOG_INF("Block count %u", block_count);
    
        if (disk_access_ioctl(disk_pdrv, DISK_IOCTL_GET_SECTOR_SIZE, &block_size)) {
            LOG_ERR("Unable to get sector size");
            return false;
        }

        LOG_INF("Sector size %u\n", block_size);
    
        memory_size_mb = (uint64_t)block_count * block_size;

        LOG_INF("Memory Size(MB) %u\n", (uint32_t)(memory_size_mb >> 20));
    } while (0);

    mp.mnt_point = disk_mount_pt;
    int res = fs_mount(&mp);
    
    if (res == FR_OK) {
        LOG_INF("Disk mounted.\n");
        lsdir(disk_mount_pt);

        struct fs_file_t fp;
        
        // check if file exists
        int ret = fs_open(&fp, counter_file, 0);
        if (ret == 0) {
            fs_close(&fp);
        } 
        if (ret == -2) {
            LOG_INF("File does not exist, creating new one!\n");
            ret = fs_open(&fp, counter_file, FS_O_CREATE | FS_O_WRITE);
            if (ret == 0) {
                char buf[2] = "0";
                fs_write(&fp, &buf, 1);
                fs_close(&fp);
                LOG_INF("Write 0 to the file\n");
            }
        }
 
        ret = fs_open(&fp, counter_file, FS_O_READ);
        
        if (ret == 0) {
            char buf[5];
            fs_read(&fp, buf, 5);
            fs_close(&fp);
            sscanf(buf, "%ld", &counter);
            LOG_INF("counter=%ld\n", counter);
        } else {
            LOG_ERR("counter could not be initialized\n");
            return false;
        }
    } else {
        LOG_ERR("Error mounting disk.\n");
        return false;
    }

    return true;
}


bool write_to_sd(const char *label, int16_t *buf, size_t bufsize)
{
    struct fs_file_t fp;
    char datafile[25];

    // convert first space to underscore
    char *ptr = strchr(label, ' ');
    if (ptr!=NULL) {
        ptr[0] = '_';
    }

    counter += 1;
    
    sprintf(datafile, "/SD:/%s.%ld.csv", label, counter); 
    LOG_INF("counter=%ld, datafile: %s\n", counter, datafile);

    int ret = fs_open(&fp, datafile, FS_O_CREATE | FS_O_WRITE);

    if (ret != 0) {
        LOG_ERR("Failed to open file: %d\n", ret);
        return false;
    }
    
    LOG_ERR("Start writing to %s\n", datafile);
    
    for (uint16_t i=0; i<bufsize; i += 3) {
        char line[20];
        ssize_t bufsz = snprintf(line, 20,  "%d,%d,%d\n", buf[i], buf[i+1], buf[i+2]);
        
        //LOG_INF("line=%s", line);

        ret = fs_write(&fp, line, bufsz);

        if (ret < 0) {
            LOG_ERR("Failed to write: %d\n", ret);
            return false;
        }
    }
 
    fs_close(&fp);

    ret = fs_open(&fp, counter_file, FS_O_WRITE);
    if (ret == 0) {
        char buf[5];
        ssize_t bufsz = snprintf(buf, 5, "%ld", counter);
        fs_write(&fp, buf, bufsz);
        fs_close(&fp);
        LOG_INF("counter=%ld written to the file\n", counter);
    } 
    fs_close(&fp);
    
    LOG_INF("Data written to %s\n", datafile);

    return true;
}

static int lsdir(const char *path)
{
        int res;
        struct fs_dir_t dirp;
        static struct fs_dirent entry;

        /* Verify fs_opendir() */
        res = fs_opendir(&dirp, path);
        if (res) {
            LOG_ERR("Error opening dir %s [%d]\n", path, res);
            return res;
        }

        LOG_INF("\nListing dir %s ...\n", path);
        for (;;) {
            /* Verify fs_readdir() */
            res = fs_readdir(&dirp, &entry);

            /* entry.name[0] == 0 means end-of-dir */
            if (res || entry.name[0] == 0) {
                break;
            }

            if (entry.type == FS_DIR_ENTRY_DIR) {
                LOG_INF("[DIR ] %s\n", entry.name);
            } else {
                LOG_INF("[FILE] %s (size = %zu)\n", entry.name, entry.size);
            }
        }

        /* Verify fs_closedir() */
        fs_closedir(&dirp);

        return res;
}
```
